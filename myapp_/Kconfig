## myapp_/Kconfig
```kconfig
config CUSTOM_MYAPP
	tristate "myapp temperature sensor example"
	default n
	---help---
		Enable the myapp example

if CUSTOM_MYAPP

config CUSTOM_MYAPP_PROGNAME
	string "Program name"
	default "myapp"
	---help---
		This is the name of the program that will be used when the NSH ELF
		program is installed.

config CUSTOM_MYAPP_PRIORITY
	int "myapp task priority"
	default 100

config CUSTOM_MYAPP_STACKSIZE
	int "myapp stack size"
	default DEFAULT_TASK_STACKSIZE

endif
```
